#include <SPI.h>
#include <MFRC522.h>
#include <LiquidCrystal.h>// include the library code:
#define SS_PIN 10 //RX slave select
#define RST_PIN 9

MFRC522 mfrc522(SS_PIN, RST_PIN); // Create MFRC522 instance.
LiquidCrystal lcd(7, 6, 5, 4, 3, 2);
String card_ID=""; //card UID

//Add as many cards you want 
String Name1="19225314437";//first UID card
String Name2="18520013187";//second UID card
String Name3="18313885211";//third UID card
String Name4="13937143185";//fourth UID card

int NumbCard[4];//the number of cards. in my case I have 6 cards.
int j=0;  //incresd by one for every user you add
int statu[4];//the number of cards. in my case I have 6 cards.
int s=0;  //incresd by one for every user you add 

String Log;
String Name;//user name
long Roll_Number;//user number
int n ;//The number of card you want to detect (optional)  
int ID=1;
void setup() {
  lcd.begin(16, 2);
  Serial.begin(9600); // Initialize serial communications with the PC
  SPI.begin();  // Init SPI bus
  mfrc522.PCD_Init(); // Init MFRC522 card
  
  Serial.println("CLEARSHEET");                 // clears starting at row 1
  Serial.println("      Name       |      Roll_Number    |      Card_ID       ");// make four columns (Date,Time,[Name:"user name"]line 48 & 52,[Number:"user number"]line 49 & 53)
  
  lcd.setCursor(2,0);
  lcd.print("Good Morning");//Wlecome Message will appear in the beginning. 
  delay(200);
   }
   
void loop() {
  //look for new card
   if ( ! mfrc522.PICC_IsNewCardPresent()) {
  return;//got to start of loop if there is no card present
 }
 // Select on0.e of the cards
 if ( ! mfrc522.PICC_ReadCardSerial()) {
  return;//if read card serial(0) returns 1, the uid struct contians the ID of the read card.
 }

 for (byte i = 0; i < mfrc522.uid.size; i++) {
     card_ID += mfrc522.uid.uidByte[i];
 }
 
       if(card_ID==Name1){
       Name="Yogendra pratap";//user name
       Roll_Number=1518731124;//user number
       j=0;//incresd by one for every user you add
       s=0;//++


































































































































































































































































































































































































































































































































































































































































































































































































































































































































































































































































































































































































































































































































































































































































































































































































































































































































































































































































































































































































































































































































































































































































































































































































































































































































































































































































































































































































































































































































































































































































































































































































































































































































































































































































































































































































































































































































































































































































































































































































































































































































































































































































































































































































































































































































































































































































































































































































































































































































































































































































































































































































































































































































































































































































































































































































































































































































































































































+







      }
      else if(card_ID==Name2){
       Name="Megha Singh";//user name
       Roll_Number=1518731059;//user number
       j=1;//++1
       s=1;//++1
      }
      else if(card_ID==Name3){
       Name="Vikas Yadav";//user name
       Roll_Number=1518731117;//user number
       j=2;//++1
       s=2;//++1
      }
      else if(card_ID==Name4){
       Name="Divyani tyagi";//user name
       Roll_Number=789101;//user number
       j=3;//++1
       s=3;//++1
      }
      
      Serial.println(Name);
      Serial.println(Roll_Number); //send the Number to excel
      Serial.println(card_ID); //send the card ID to excel
     
     
}
    
